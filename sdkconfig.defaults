## sdkconfig.defaults
```kconfig
# Serial flasher config
CONFIG_ESPTOOLPY_FLASHSIZE_4MB=y
CONFIG_ESPTOOLPY_FLASHFREQ_80M=y
CONFIG_ESPTOOLPY_BAUD_921600B=y

# FreeRTOS
CONFIG_FREERTOS_HZ=1000

# UART
CONFIG_ESP_CONSOLE_UART_DEFAULT=y

# NVS
CONFIG_NVS_ENCRYPTION=n

# Log level
CONFIG_LOG_DEFAULT_LEVEL_INFO=y
```
